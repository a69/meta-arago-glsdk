## meta-arago-distro/conf/distro/include/branding-glsdk.inc
```bitbake
# GLSDK branding configuration

# Use the SDK supported kernel and kernel version
PREFERRED_PROVIDER_virtual/kernel = "linux-ti-glsdk"
PREFERRED_PROVIDER_virtual/bootloader = "u-boot-glsdk-staging"
PREFERRED_PROVIDER_libgbm = "libgbm-glsdk"
PREFERRED_VERSION_libgbm = "9.0.0"
```
